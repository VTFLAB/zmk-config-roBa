## config/west.yml
```yaml
manifest:
  remotes:
    - name: zmkfirmware
      url-base: https://github.com/zmkfirmware
    - name: kumamuk-git
      url-base: https://github.com/kumamuk-git
    - name: vtflab
      url-base: https://github.com/VTFLAB
  projects:
    - name: zmk
      remote: vtflab
      revision: 1b26a0c156f36a08d756be4757d6228b29dd0351
      import: app/west.yml
    - name: zmk-pmw3610-driver
      remote: kumamuk-git
      revision: main
  self:
    path: config
```
